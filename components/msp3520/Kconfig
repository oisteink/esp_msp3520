## components/msp3520/Kconfig
```kconfig
menu "MSP3520 Display Module"

    orsource "$IDF_PATH/examples/common_components/env_caps/$IDF_TARGET/Kconfig.env_caps"

    menu "Display SPI"
        choice MSP3520_DISPLAY_SPI_HOST
            prompt "SPI Host"
            default MSP3520_DISPLAY_SPI2

            config MSP3520_DISPLAY_SPI2
                bool "SPI2"
            config MSP3520_DISPLAY_SPI3
                bool "SPI3"
                depends on SOC_SPI_PERIPH_NUM > 2
        endchoice

        config MSP3520_DISPLAY_SPI_HOST_ID
            int
            default 1 if MSP3520_DISPLAY_SPI2
            default 2 if MSP3520_DISPLAY_SPI3

        config MSP3520_DISPLAY_SCLK_GPIO
            int "SCLK GPIO"
            range ENV_GPIO_RANGE_MIN ENV_GPIO_OUT_RANGE_MAX
            default 11

        config MSP3520_DISPLAY_MOSI_GPIO
            int "MOSI GPIO"
            range ENV_GPIO_RANGE_MIN ENV_GPIO_OUT_RANGE_MAX
            default 10

        config MSP3520_DISPLAY_MISO_GPIO
            int "MISO GPIO"
            range -1 ENV_GPIO_OUT_RANGE_MAX
            default 13
            help
                Set to -1 if not connected.

        config MSP3520_DISPLAY_CS_GPIO
            int "CS GPIO"
            range ENV_GPIO_RANGE_MIN ENV_GPIO_OUT_RANGE_MAX
            default 3

        config MSP3520_DISPLAY_DC_GPIO
            int "DC GPIO"
            range ENV_GPIO_RANGE_MIN ENV_GPIO_OUT_RANGE_MAX
            default 9

        config MSP3520_DISPLAY_RST_GPIO
            int "RST GPIO (-1 = software reset)"
            range -1 ENV_GPIO_OUT_RANGE_MAX
            default 46

        config MSP3520_DISPLAY_BKL_GPIO
            int "Backlight GPIO (-1 = none)"
            range -1 ENV_GPIO_OUT_RANGE_MAX
            default 12

        config MSP3520_DISPLAY_BKL_ACTIVE_HIGH
            bool "Backlight active high"
            default y

        config MSP3520_DISPLAY_SPI_CLOCK_MHZ
            int "SPI clock (MHz)"
            range 1 80
            default 40
    endmenu

    menu "Touch SPI"
        choice MSP3520_TOUCH_SPI_HOST
            prompt "SPI Host"
            default MSP3520_TOUCH_SPI3 if SOC_SPI_PERIPH_NUM > 2
            default MSP3520_TOUCH_SPI2

            config MSP3520_TOUCH_SPI2
                bool "SPI2"
            config MSP3520_TOUCH_SPI3
                bool "SPI3"
                depends on SOC_SPI_PERIPH_NUM > 2
        endchoice

        config MSP3520_TOUCH_SPI_HOST_ID
            int
            default 1 if MSP3520_TOUCH_SPI2
            default 2 if MSP3520_TOUCH_SPI3

        config MSP3520_TOUCH_SCLK_GPIO
            int "SCLK GPIO"
            range ENV_GPIO_RANGE_MIN ENV_GPIO_OUT_RANGE_MAX
            default 6

        config MSP3520_TOUCH_MOSI_GPIO
            int "MOSI GPIO"
            range ENV_GPIO_RANGE_MIN ENV_GPIO_OUT_RANGE_MAX
            default 7

        config MSP3520_TOUCH_MISO_GPIO
            int "MISO GPIO"
            range ENV_GPIO_RANGE_MIN ENV_GPIO_OUT_RANGE_MAX
            default 8

        config MSP3520_TOUCH_CS_GPIO
            int "CS GPIO"
            range ENV_GPIO_RANGE_MIN ENV_GPIO_OUT_RANGE_MAX
            default 4

        config MSP3520_TOUCH_IRQ_GPIO
            int "IRQ GPIO (-1 = polling)"
            range -1 ENV_GPIO_OUT_RANGE_MAX
            default 5

        config MSP3520_TOUCH_Z_THRESHOLD
            int "Touch pressure threshold"
            range 10 1000
            default 100
            help
                Touch pressure less than this value will be discarded.
                Stylus: 300-500. Finger: 50-150.

        config MSP3520_TOUCH_SPI_CLOCK_KHZ
            int "Touch SPI clock (kHz)"
            range 100 2500
            default 1000
            help
                SPI clock for the XPT2046 touch controller.
                Datasheet max is 2.5 MHz. Default 1 MHz.
    endmenu

    menu "LVGL"
        choice MSP3520_LVGL_TASK_CORE
            prompt "LVGL task core affinity"
            default MSP3520_LVGL_CORE_NO_AFFINITY
            depends on !FREERTOS_UNICORE

            config MSP3520_LVGL_CORE_NO_AFFINITY
                bool "No affinity"
            config MSP3520_LVGL_CORE_0
                bool "Core 0"
            config MSP3520_LVGL_CORE_1
                bool "Core 1"
        endchoice

        config MSP3520_LVGL_TASK_CORE_ID
            int
            default -1 if MSP3520_LVGL_CORE_NO_AFFINITY || FREERTOS_UNICORE
            default 0 if MSP3520_LVGL_CORE_0
            default 1 if MSP3520_LVGL_CORE_1

        config MSP3520_LVGL_TASK_PRIORITY
            int "LVGL task priority"
            range 1 25
            default 2

        config MSP3520_LVGL_TASK_STACK_SIZE
            int "LVGL task stack size (bytes)"
            range 4096 32768
            default 8192

        config MSP3520_LVGL_DRAW_BUF_LINES
            int "Draw buffer height (lines)"
            range 48 480
            default 48
            help
                Height of each LVGL draw buffer in lines.
                Two buffers of this size are allocated from internal RAM.
                Minimum is 1/10th of vertical resolution (48 lines).
    endmenu

    menu "XPT2046 Advanced"
        config MSP3520_XPT2046_INTERRUPT_MODE
            bool "Use PENIRQ interrupt"
            default y
            help
                Enable PENIRQ output from XPT2046. When enabled, the IRQ pin
                goes low when the screen is touched. Required for IRQ-driven
                touch detection to avoid continuous SPI polling.

        config MSP3520_XPT2046_VREF_ON_MODE
            bool "Keep internal Vref on between conversions"
            default n
            help
                Uses slightly more power, but requires fewer transactions when
                reading battery voltage, aux voltage and temperature.
    endmenu

endmenu
```

## components/xpt2046/Kconfig.projbuild
```kconfig
menu "XPT2046"
    config XPT2046_Z_THRESHOLD
        int "Minimum Z pressure threshold"
        default 100
        help
            Touch pressure less than this value will be discarded as invalid
            and no touch position data collected.
            Stylus use: 300-500. Finger use: 50-150.

    config XPT2046_INTERRUPT_MODE
        bool "Enable Interrupt (PENIRQ) output"
        default y
        help
            Enable PENIRQ output from XPT2046. When enabled, the IRQ pin
            goes low when the screen is touched. Required for IRQ-driven
            touch detection to avoid continuous SPI polling.

    config XPT2046_VREF_ON_MODE
        bool "Keep internal Vref enabled"
        default n
        help
            Enable this to keep the internal Vref enabled between conversions.
            This uses slightly more power, but requires fewer transactions when
            reading the battery voltage, aux voltage and temperature.

    config XPT2046_CONVERT_ADC_TO_COORDS
        bool "Convert touch coordinates to screen coordinates"
        default y
        help
            When this option is enabled the raw ADC values will be converted from
            0-4096 to 0-{screen width} or 0-{screen height}.
            When this option is disabled the process_coordinates method will need
            to be used to convert the raw ADC values into a screen coordinate.

    config XPT2046_ENABLE_LOCKING
        bool "Enable data structure locking"
        default n
        help
            By enabling this option the XPT2046 driver will lock the touch position
            data structures when reading values from the XPT2046 and when reading
            position data via API.
            WARNING: enabling this option may result in unintended crashes.
endmenu
```

## examples/finger-paint/sdkconfig.defaults
```kconfig
# Target
CONFIG_IDF_TARGET="esp32s3"

# Display pins
CONFIG_MSP3520_DISPLAY_SCLK_GPIO=11
CONFIG_MSP3520_DISPLAY_MOSI_GPIO=10
CONFIG_MSP3520_DISPLAY_MISO_GPIO=13
CONFIG_MSP3520_DISPLAY_CS_GPIO=3
CONFIG_MSP3520_DISPLAY_DC_GPIO=9
CONFIG_MSP3520_DISPLAY_RST_GPIO=46
CONFIG_MSP3520_DISPLAY_BKL_GPIO=12
CONFIG_MSP3520_DISPLAY_SPI_CLOCK_MHZ=40

# Touch pins (SPI3, dedicated bus)
CONFIG_MSP3520_TOUCH_SCLK_GPIO=6
CONFIG_MSP3520_TOUCH_MOSI_GPIO=7
CONFIG_MSP3520_TOUCH_MISO_GPIO=8
CONFIG_MSP3520_TOUCH_CS_GPIO=4
CONFIG_MSP3520_TOUCH_IRQ_GPIO=5

# Flash - octal SPI, 32MB
CONFIG_ESPTOOLPY_OCT_FLASH=y
CONFIG_ESPTOOLPY_FLASHSIZE_32MB=y
CONFIG_ESPTOOLPY_HEADER_FLASHSIZE_UPDATE=y

# PSRAM - octal SPI, 80MHz
CONFIG_SPIRAM=y
CONFIG_SPIRAM_MODE_OCT=y
CONFIG_SPIRAM_SPEED_80M=y

# FreeRTOS - 1kHz tick for lower LVGL task latency (1ms vs 10ms)
CONFIG_FREERTOS_HZ=1000

# Task watchdog - don't watch idle tasks (LVGL task may block)
CONFIG_ESP_TASK_WDT_CHECK_IDLE_TASK_CPU0=n
CONFIG_ESP_TASK_WDT_CHECK_IDLE_TASK_CPU1=n

# Logging - allow DEBUG level at compile time
CONFIG_LOG_MAXIMUM_LEVEL=4

# LVGL
CONFIG_LV_COLOR_DEPTH_24=y
CONFIG_LV_FONT_MONTSERRAT_28=y
CONFIG_LV_DEF_REFR_PERIOD=10

# Touch SPI - 2 MHz (XPT2046 max is 2.5 MHz)
CONFIG_MSP3520_TOUCH_SPI_CLOCK_KHZ=2000

# LVGL performance monitor
CONFIG_LV_USE_SYSMON=y
CONFIG_LV_USE_PERF_MONITOR=y
```

## main/Kconfig.projbuild
```kconfig
menu "ILI9488 Display Configuration"

    orsource "$IDF_PATH/examples/common_components/env_caps/$IDF_TARGET/Kconfig.env_caps"

    config LCD_SPI_SCLK_GPIO
        int "SPI SCLK GPIO"
        range ENV_GPIO_RANGE_MIN ENV_GPIO_OUT_RANGE_MAX
        default 6
        help
            GPIO number for the SPI clock line.

    config LCD_SPI_MOSI_GPIO
        int "SPI MOSI GPIO"
        range ENV_GPIO_RANGE_MIN ENV_GPIO_OUT_RANGE_MAX
        default 7
        help
            GPIO number for the SPI MOSI line.

    config LCD_SPI_MISO_GPIO
        int "SPI MISO GPIO"
        range -1 ENV_GPIO_OUT_RANGE_MAX
        default -1
        help
            GPIO number for the SPI MISO line. Set to -1 if not connected.

    config LCD_CS_GPIO
        int "LCD CS GPIO"
        range ENV_GPIO_RANGE_MIN ENV_GPIO_OUT_RANGE_MAX
        default 20
        help
            GPIO number for the LCD chip select line.

    config LCD_DC_GPIO
        int "LCD DC GPIO"
        range ENV_GPIO_RANGE_MIN ENV_GPIO_OUT_RANGE_MAX
        default 21
        help
            GPIO number for the LCD data/command line.

    config LCD_RST_GPIO
        int "LCD RST GPIO"
        range -1 ENV_GPIO_OUT_RANGE_MAX
        default 22
        help
            GPIO number for the LCD reset line. Set to -1 for software reset.

    config LCD_BKL_GPIO
        int "LCD backlight GPIO"
        range -1 ENV_GPIO_OUT_RANGE_MAX
        default 23
        help
            GPIO number for the LCD backlight. Set to -1 to disable.

    config LCD_SPI_CLOCK_MHZ
        int "SPI clock speed (MHz)"
        range 1 40
        default 20
        help
            SPI clock frequency in MHz for the LCD.

    config TOUCH_SPI_SCLK_GPIO
        int "Touch SPI SCLK GPIO"
        range ENV_GPIO_RANGE_MIN ENV_GPIO_OUT_RANGE_MAX
        default 6
        help
            GPIO number for the touch SPI clock (SPI3, separate from display).

    config TOUCH_SPI_MOSI_GPIO
        int "Touch SPI MOSI GPIO"
        range ENV_GPIO_RANGE_MIN ENV_GPIO_OUT_RANGE_MAX
        default 7
        help
            GPIO number for the touch SPI MOSI (SPI3, separate from display).

    config TOUCH_SPI_MISO_GPIO
        int "Touch SPI MISO GPIO"
        range ENV_GPIO_RANGE_MIN ENV_GPIO_OUT_RANGE_MAX
        default 8
        help
            GPIO number for the touch SPI MISO (SPI3, separate from display).

    config TOUCH_CS_GPIO
        int "Touch CS GPIO"
        range ENV_GPIO_RANGE_MIN ENV_GPIO_OUT_RANGE_MAX
        default 4
        help
            GPIO number for the XPT2046 touch chip select.

    config TOUCH_IRQ_GPIO
        int "Touch IRQ GPIO"
        range -1 ENV_GPIO_OUT_RANGE_MAX
        default 5
        help
            GPIO number for the XPT2046 touch interrupt. Set to -1 to disable.

endmenu
```

## sdkconfig.defaults
```kconfig
# Target
CONFIG_IDF_TARGET="esp32s3"

# Pin assignments for ESP32-S3
CONFIG_LCD_SPI_SCLK_GPIO=11
CONFIG_LCD_SPI_MOSI_GPIO=10
CONFIG_LCD_SPI_MISO_GPIO=13
CONFIG_LCD_CS_GPIO=3
CONFIG_LCD_DC_GPIO=9
CONFIG_LCD_RST_GPIO=46
CONFIG_LCD_BKL_GPIO=12
CONFIG_LCD_SPI_CLOCK_MHZ=40

# Touch (SPI3, dedicated bus)
CONFIG_TOUCH_SPI_SCLK_GPIO=6
CONFIG_TOUCH_SPI_MOSI_GPIO=7
CONFIG_TOUCH_SPI_MISO_GPIO=8
CONFIG_TOUCH_CS_GPIO=4
CONFIG_TOUCH_IRQ_GPIO=5

# Flash - octal SPI, 32MB
CONFIG_ESPTOOLPY_OCT_FLASH=y
CONFIG_ESPTOOLPY_FLASHSIZE_32MB=y
CONFIG_ESPTOOLPY_HEADER_FLASHSIZE_UPDATE=y

# PSRAM - octal SPI, 80MHz
CONFIG_SPIRAM=y
CONFIG_SPIRAM_MODE_OCT=y
CONFIG_SPIRAM_SPEED_80M=y

# Task watchdog - don't watch idle tasks (LVGL blocks core 1)
CONFIG_ESP_TASK_WDT_CHECK_IDLE_TASK_CPU0=n
CONFIG_ESP_TASK_WDT_CHECK_IDLE_TASK_CPU1=n

# Logging - allow DEBUG level at compile time
CONFIG_LOG_MAXIMUM_LEVEL=4

# LVGL configuration
CONFIG_LV_COLOR_DEPTH_24=y
CONFIG_LV_FONT_MONTSERRAT_28=y
```

## test_apps/sdkconfig.defaults
```kconfig
# Target ESP32-S3
CONFIG_IDF_TARGET="esp32s3"

# Disable task watchdog so unity_run_menu() doesn't trigger it
# CONFIG_ESP_TASK_WDT_INIT is not set
CONFIG_FREERTOS_HZ=1000

# Font required by msp3520 calibration screen
CONFIG_LV_FONT_MONTSERRAT_28=y

# Screen protection: use short defaults for test convenience
CONFIG_MSP3520_SCREEN_DIM_TIMEOUT=0
CONFIG_MSP3520_SCREEN_OFF_TIMEOUT=0
```
